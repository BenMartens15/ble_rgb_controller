## main/Kconfig.projbuild
```kconfig
menu "Lightning Light Controller"
   
    choice
        prompt "Device Type"
        help
            The device type to build for.
    
        config DEVICE_TYPE_RGB_CONTROLLER
            bool "RGB Controller"
        
        config DEVICE_TYPE_LIGHT_SWITCH
            bool "Light Switch"
    
    endchoice

    config DEVICE_TYPE
        int
        default 0 if DEVICE_TYPE_RGB_CONTROLLER
        default 1 if DEVICE_TYPE_LIGHT_SWITCH

endmenu
```
